## sdkconfig.defaults
```kconfig
#
# SDK configuration
#
CONFIG_ESPTOOLPY_FLASHSIZE_4MB=y
CONFIG_LOG_DEFAULT_LEVEL_WARN=y
CONFIG_HEAP_POISONING_LIGHT=y
CONFIG_PARTITION_TABLE_CUSTOM=y
CONFIG_PARTITION_TABLE_CUSTOM_FILENAME="ESP32CS-partitions.csv"
CONFIG_PARTITION_TABLE_FILENAME="ESP32CS-partitions.csv"
CONFIG_PARTITION_TABLE_TWO_OTA=n
CONFIG_PARTITION_TABLE_SINGLE_APP=n
CONFIG_COMPILER_STACK_CHECK_MODE_NORM=y
CONFIG_COMPILER_STACK_CHECK=y
CONFIG_COMPILER_OPTIMIZATION_DEFAULT=y
CONFIG_LOG_COLORS=n

#
# TWAI Configuration
#
CONFIG_TWAI_ERRATA_FIX_TX_INTR_LOST=y
CONFIG_TWAI_ERRATA_FIX_BUS_OFF_REC=y
CONFIG_TWAI_ERRATA_FIX_RX_FRAME_INVALID=y
CONFIG_TWAI_ERRATA_FIX_RX_FIFO_CORRUPT=y

#
# ESP32 Specific
#
# NOTE: ESP-IDF defaults to 160Mhz mode!
CONFIG_ESP32_DEFAULT_CPU_FREQ_240=y
CONFIG_ESP32_DEBUG_OCDAWARE=n
CONFIG_ESP32_ULP_COPROC_ENABLED=y

#
# Bootloader configuratino
#
CONFIG_BOOTLOADER_LOG_LEVEL_WARN=y

#
# FreeRTOS configuration
#
CONFIG_FREERTOS_HZ=1000
CONFIG_FREERTOS_SUPPORT_STATIC_ALLOCATION=y
CONFIG_FREERTOS_DEBUG_OCDAWARE=n

#
# LwIP configuration
#
CONFIG_LWIP_SO_RCVBUF=y
CONFIG_LWIP_LOCAL_HOSTNAME="esp32cs"
# disable IRAM optimization due to https://github.com/espressif/esp-idf/issues/5734
CONFIG_LWIP_IRAM_OPTIMIZATION=n
CONFIG_LWIP_MAX_SOCKETS=16
CONFIG_LWIP_ETHARP_TRUST_IP_MAC=y
CONFIG_LWIP_DHCP_RESTORE_LAST_IP=y
CONFIG_LWIP_MAX_LISTENING_TCP=10
CONFIG_LWIP_IPV6=n
CONFIG_LWIP_TCPIP_TASK_AFFINITY_CPU1=y

#
# WiFi configuration
#
CONFIG_ESP32_WIFI_NVS_ENABLED=n
CONFIG_ESP32_WIFI_STATIC_RX_BUFFER_NUM=16
CONFIG_ESP32_WIFI_RX_BA_WIN=16
CONFIG_ESP32_WIFI_TASK_PINNED_TO_CORE_0=y

#
# Task stack configuration
#
CONFIG_ESP_MAIN_TASK_STACK_SIZE=10240
CONFIG_ESP_IPC_TASK_STACK_SIZE=2048
CONFIG_ESP_SYSTEM_EVENT_TASK_STACK_SIZE=2816

#
# Watchdog configuration
#
CONFIG_ESP_INT_WDT_TIMEOUT_MS=1800
CONFIG_ESP_TASK_WDT=n

#
# FATFS configuration
#
CONFIG_FATFS_LFN_HEAP=y

#
# pthread configuration
#
CONFIG_PTHREAD_TASK_PRIO_DEFAULT=1
CONFIG_PTHREAD_TASK_STACK_SIZE_DEFAULT=2048


#
# Core dump
#
CONFIG_ESP_COREDUMP_ENABLE_TO_FLASH=y
CONFIG_ESP_COREDUMP_DATA_FORMAT_ELF=y

#
# SPIFFS configuration
#
CONFIG_SPIFFS_MAX_PARTITIONS=1

#
# mbedTLS configuration
#
CONFIG_MBEDTLS_HARDWARE_MPI=y
CONFIG_MBEDTLS_TLS_CLIENT_ONLY=y
CONFIG_MBEDTLS_TLS_CLIENT=y
CONFIG_MBEDTLS_TLS_ENABLED=y
CONFIG_MBEDTLS_ECP_C=y
CONFIG_MBEDTLS_ECDH_C=y
CONFIG_MBEDTLS_ECDSA_C=y
CONFIG_MBEDTLS_ECP_DP_SECP192R1_ENABLED=y
CONFIG_MBEDTLS_ECP_DP_SECP224R1_ENABLED=y
CONFIG_MBEDTLS_ECP_DP_SECP256R1_ENABLED=y
CONFIG_MBEDTLS_ECP_DP_SECP384R1_ENABLED=y
CONFIG_MBEDTLS_ECP_DP_SECP521R1_ENABLED=y
CONFIG_MBEDTLS_ECP_DP_SECP192K1_ENABLED=y
CONFIG_MBEDTLS_ECP_DP_SECP224K1_ENABLED=y
CONFIG_MBEDTLS_ECP_DP_SECP256K1_ENABLED=y
CONFIG_MBEDTLS_ECP_DP_BP256R1_ENABLED=y
CONFIG_MBEDTLS_ECP_DP_BP384R1_ENABLED=y
CONFIG_MBEDTLS_ECP_DP_BP512R1_ENABLED=y
CONFIG_MBEDTLS_ECP_DP_CURVE25519_ENABLED=y
CONFIG_MBEDTLS_ECP_NIST_OPTIM=y

#
# WPA configuration
#
# NOTE: the option below requires CONFIG_MBEDTLS_HARDWARE_MPI to be enabled,
# see https://github.com/espressif/esp-idf/issues/5321 for details.
CONFIG_WPA_MBEDTLS_CRYPTO=y
```
